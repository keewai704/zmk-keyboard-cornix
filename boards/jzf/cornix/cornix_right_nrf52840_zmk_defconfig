## boards/jzf/cornix/cornix_right_nrf52840_zmk_defconfig
```kconfig
# SPDX-License-Identifier: MIT

CONFIG_ADC_NRFX_SAADC=y
CONFIG_ARM_MPU=y
CONFIG_PINCTRL=y
CONFIG_GPIO=y
CONFIG_USE_DT_CODE_PARTITION=y
CONFIG_BUILD_OUTPUT_UF2=y
CONFIG_MPU_ALLOW_FLASH_WRITE=y
CONFIG_NVS=y
CONFIG_SETTINGS_NVS=y
CONFIG_FLASH=y
CONFIG_FLASH_PAGE_LAYOUT=y
CONFIG_FLASH_MAP=y
CONFIG_CLOCK_CONTROL_NRF=y
CONFIG_CLOCK_CONTROL_NRF_K32SRC_RC=y

CONFIG_ZMK_SPLIT=y
CONFIG_ZMK_BLE=y
CONFIG_ZMK_USB=n
CONFIG_INPUT=y

# nRF52840 BLE stability for split traffic.
CONFIG_BT_CTLR_ADVANCED_FEATURES=y
CONFIG_BT_CTLR_ASSERT_OVERHEAD_START=n
CONFIG_SOC_FLASH_NRF_PARTIAL_ERASE=y

CONFIG_EC11=y
CONFIG_EC11_TRIGGER_GLOBAL_THREAD=y

# DYA Studio peripheral relay support. Studio itself runs only on the central.
CONFIG_ZMK_SETTINGS_RPC=y
CONFIG_ZMK_CUSTOM_SETTINGS=y
CONFIG_ZMK_CUSTOM_SETTINGS_SPLIT_RPC_RELAY=y
CONFIG_ZMK_SPLIT_RELAY_EVENT=y
CONFIG_ZMK_SETTINGS_SAVE_DEBOUNCE=10000
CONFIG_ZMK_LOW_PRIORITY_THREAD_STACK_SIZE=2048
CONFIG_ZMK_SPLIT_RELAY_EVENT_DATA_LEN=240
```

## config/west.yml
```yaml
manifest:
  remotes:
    - name: zmkfirmware
      url-base: https://github.com/zmkfirmware
    - name: hitsmaxft
      url-base: https://github.com/hitsmaxft
    - name: englmaxi
      url-base: https://github.com/englmaxi
    - name: urob
      url-base: https://github.com/urob
    - name: janpfischer
      url-base: https://github.com/janpfischer
    - name: cormoran
      url-base: https://github.com/cormoran
  projects:
    # DYA Studio's extended RPC features require cormoran's ZMK fork.
    - name: zmk
      remote: cormoran
      revision: main+dya
      clone-depth: 1
      import:
        file: app/west.yml

    - name: zmk-helpers
      remote: urob
      revision: main
      clone-depth: 1
    - name: zmk-dongle-display
      remote: englmaxi
      revision: main
      clone-depth: 1

    # DYA Studio runtime/configuration extensions.
    - name: zmk-module-ble-management
      remote: cormoran
      revision: main
      clone-depth: 1
    - name: zmk-module-battery-history
      remote: cormoran
      revision: main
      clone-depth: 1
    - name: zmk-module-settings-rpc
      remote: cormoran
      revision: main
      clone-depth: 1
    - name: zmk-module-runtime-input-processor
      remote: cormoran
      revision: main
      clone-depth: 1
    - name: zmk-feature-input-stream
      remote: cormoran
      revision: main
      clone-depth: 1
    - name: zmk-feature-module-physical-layout
      remote: cormoran
      revision: main
      clone-depth: 1
    - name: zmk-feature-custom-settings
      remote: cormoran
      revision: main
      clone-depth: 1
    - name: zmk-feature-runtime-combo
      remote: cormoran
      revision: main
      clone-depth: 1
    - name: zmk-feature-runtime-macro
      remote: cormoran
      revision: main
      clone-depth: 1
    - name: zmk-feature-os-detection
      remote: cormoran
      revision: main
      clone-depth: 1
    - name: zmk-feature-default-layer
      remote: cormoran
      revision: codex/custom-rpc-rewrite
      clone-depth: 1
      import: true
    - name: zmk-feature-device-info
      remote: cormoran
      revision: main
      clone-depth: 1
    - name: zmk-feature-kscan-diagnostics
      remote: cormoran
      revision: main
      clone-depth: 1
    - name: zmk-feature-watchdog
      remote: cormoran
      revision: main
      clone-depth: 1
    - name: zmk-feature-fast-keymap
      remote: cormoran
      revision: main
      clone-depth: 1
    - name: zmk-behavior-runtime-sensor-rotate
      remote: cormoran
      revision: main
      clone-depth: 1

    # Optional display module retained from the upstream Cornix config.
    #- name: zmk-dongle-screen
    #  remote: janpfischer
    #  revision: main
    #  clone-depth: 1
  self:
    path: config
```
